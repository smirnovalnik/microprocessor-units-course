/**
  ******************************************************************************
  * \file    c_lang_base.c
  * \author  Александр Смирнов
  * \version 1.0.1
  * \date    12.02.2023
  * \brief   Программа на языке C для учебного стенда на базе
  *          STM32F072RBT6 в среде разработки Keil uVision 5.
  *          Подключение библиотек поддержки МК STM32F072RBT6 осуществляется
  *          средствами IDE Keil через менеджер пакетов Run-Time Environment (RTE).
  *          В программе показаны основы синтаксиса языка C.
  ******************************************************************************
  */


/* Функция main - точка входа в программу.
   В любой программе на языке C должна быть одна функция main.
   В ней начинается исполнение программы. */
int main(void)
{
    /* Объявление и инициализация переменных */
    int a = 1; /* Объявление целочисленной переменной a и присвоение ей числа 1 */
    int b = 2;
    int c;     /* Объявление целочисленной переменной c без инициализации */

    /* Арифметические операторы */
    c = a + b;      /* Сложение */
    c = a + 10;
    c = a - b;      /* Вычитание */
    c = a * b;      /* Умножение */
    c = 100 / b;    /* Целочисленное деление */
    c = a / b;

    /* Логические операторы */
    c = a & 2;      /* Логическое И */
    c = a | 3;      /* Логическое ИЛИ */
    c = a ^ 1;      /* Логическое Исключающее ИЛИ */
    c = ~b;         /* Логическое побитовое НЕ */
    c = a << 4;     /* Сдвиг вправо */
    c = a >> 1;     /* Сдвиг влево */

    /* Массив */
    int arr[10];    /* Объявление массива из десяти элементов типа int */
    arr[0] = -1;    /* Присваивание элементу 0 (первый элемент) числа -1. Индексация в массивах с 0 */
    arr[9] = 1;     /* Присваивание элементу 9 (последний элемент) числа 1.*/

    /* Условный оператор */
    if (a > 0)
    {
        c = 1; /* Будет выполнятся эта строчка, так как a > 0 (a = 1) */
    }
    else
    {
        c = -1;
    }

    /* Циклы */
    int i = 0;      /* Объявление и инициализации счетчика цикла */
    while (i < 10)  /* Повторить действия в {} пока i < 0 */
    {
        arr[i] = i; /* Присваивание элементу с индексом i числа i */
        i++;        /* Инкремент счетчика цикла */
    }

    /* Цикл for аналогичен циклу while.*/
    for (int j = 0; j < 10; j++)
    {
        arr[j] = 10 - j;
    }
}
