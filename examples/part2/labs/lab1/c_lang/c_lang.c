/**
  ******************************************************************************
  * \file    c_lang.c
  * \author  Александр Смирнов
  * \version 1.0.0
  * \date    1.02.2023
  * \brief   Пример программа для лабораторной работы №1 на языке C
  *          для учебного стенда на базе STM32F072RBT6
  *          в среде разработки Keil uVision 5.
  *          В программе показан основы синтаксиса языка C.
  *          Программа не имеет привязки к микроконтролеру и может
  *          запускаться в симуляторе или на любой системе с компилятором C.
  *          Некоторые выражения являются ошибочными и помещены в комментарии.
  ******************************************************************************
  */

/* Это многострочный комментарий.
   Комментарии полностью игнорируются компилятором */

// Это однострочный комментарий

/* Это прототипы функций. Нужны для последней части примера */
int abs(int n);
int arr_max(int a[], int n);

/* Функция main - точка входа в программу.
   В любой программе на языке C должна быть одна функция main.
   В ней начинается исполнение программы. */
int main(void)
{
    /* 1. Имена объектов */

    //te+st/ = 1; /* Ошибка: имена должны содержать только буквы, цифры и символ _ */
    //1test = 3;  /* Ошибка: имена не должны начинаться с цифры */
    //test = 4;   /* Нет ошибки */

    /* Test и test разные объекты - регистр имеет значение */
    //Test = 5;
    //test = 6;

    //TestLab1 = 7;         /* Нет ошибки: CamelCase */
    //lesson_number_1 = 8;  /* Нет ошибки: snake_case */
    //MPEI_ER_02_13 = 2;    /* Нет ошибки: SCREAMING_SNAKE_CASE */


    /* 2. Объявление переменных */

    /* Объявление целочисленной переменной со знаком (дополнительный код со знаком) */
    int i;

    /* Объявление беззнаковых целочисленных переменных */
    unsigned int j, k;

    /* Объявление переменной с плавающей запятой (32 бит) */
    float f;

    /* Инициализация символьной переменной */
    char ch;


    /* 3. Оператор присваивания */

    /* Объявление и инициализация переменных */
    int var1 = 1;
    int var2 = 2;
    int tmp;

    /* Обмен значений a и b */
    tmp = var1;
    var1 = var2;
    var2 = tmp; /* var1 = 2, var2 = 1 */

    /* Множественное присваивание */
    i = j = 0; /* j = 0 и затем i = j */


    /* 4. Арифметические операции */

    int a, b, c; /* Объявление целочисленных переменных со знаком а, b, c */

    /* Присваивание переменной a значения 0, переменной b значения 1 */
    a = 0;
    b = 1;

    /* Сложение и вычитание */
    c = a + b; /* с = 1 */
    c = a - b; /* с = -1 */

    /* Присваивание других значений переменным a и b */
    a = 10;
    b = 2;

    /* Умножение и деление */
    c = a * b; /* с = 20 */
    c = a / b; /* с = 5 */
    c = a / 3; /* c = 3 */
    c = a / 100; /* c = 0 */

    /* Остаток от деления */
    a = 12;
    c = a % 10;  /* c = 2 */


    /* 5. Арифметические операции: сокращенная форма */

    i = 0;
    /* Инкремент */
    i++; /* i = 1 */
    /* Декремент */
    i--; /* i = 0 */


    /* 6. Битовые операции */

    /* 0xА - шестнадцатеричная форма,
       012 - восьмеричная форма,
       10 - десятичная форма */

    a = 0x81;

    /* Побитовое И */
    a = a & 0xFE; /* Сброс бита a = 0x80 */

    /* Побитовое ИЛИ */
    a = a | 0x02; /* Установка бита a = 0x82 */

    /* Побитовое ИСКЛЮЧАЮЩЕЕ ИЛИ */
    a = a ^ 0x01; /* Инверсия бита a = 0x83 */
    a = a ^ 0x01; /* Инверсия бита a = 0x82 */

    /* Побитовая ИНВЕРСИЯ */
    a = ~a; /* Инверсия a = 0xFFFFFF7D */

    a = 0x01;
    /* Сдвиги */
    a = a << 2; /* Сдвиг влево a = 0x04 */
    a = a >> 1; /* Сдвиг вправо a = 0x02 */


    /* 7. Оператор ветвления */

    /* Простая форма без {}
      if (выражение)
          оператор;
    */

    if (a % 2 == 0)
        i++; // Одно утверждение

    /* Простая форма с {}
      if (выражение) {
          оператор1;
          оператор2;
      }
    */

    if (a == 0) {
        b = 100;
        c = 10;
    }


    /* 8. Оператор ветвления */

    /* Полная форма
      if (выражение) {
          оператор1;
      }
      else {
          оператор2;
      }
    */

    a = 1;
    if (a < 0) {
        c = 1;
    }
    else {
        c = -1;
    }

    /*
    if (выражение1) {
        оператор1;
    }
    else if (выражение2) {
        оператор2;
    }
    else {
        оператор3;
    }*/

    if (a == 0) {
        c = 1;;
    }
    else if (a == 1) {
        c = 2;
    }
    else {
        c = 3;;
    }


    /* 9. Операция сравнения и логические операции */

    if (a <= 0) {
        a = 0;
    }

    if ((b & 0x01) == 0) {
        a = 42;
    }

    if ((a > 0) && (a != 10)) {
        b = 10;
    }


    /* 10. Массивы */

    /* Объявление массива без инициализации */
    int arr[10];

    arr[0] = 1;  /* Первый элемент */
    arr[1] = 4;  /* Второй элемент */
    arr[9] = 99; /* Последний элемент */

    /* Компилятор не проверяет выход за пределы */
    //arr[-1] = 100; /* Ошибка при исполнении */
    //arr[10] = 100; /* Ошибка при исполнении */

    /* Объявление массива с инициализацией */
    char prime[] = {2, 3, 5, 7, 11, 13, 17, 19};

    /* Многомерные массивы */
    int marr[10][10];

    marr[0][0] = 13; /* Первый элемент */
    marr[0][1] = 27;
    marr[0][9] = 43;
    marr[1][0] = 69;
    marr[9][8] = 87;
    marr[9][9] = 91; /* Последний элемент */


    /* 11. Операторы цикла */

    /* Цикл while
      while (выражение) {
          оператор;
    }
    */
    i = 0;
    while (i < 10) {
        arr[i] = i;
        i++;
    }

    /* Цикл do-while
      do {
          оператор;
      } while (выражение);
    */

    i = 0;
    do {
        j = 10 - i;
        arr[i] = j;
        i++;
    } while (i < 10);

    /* Цикл for */
    /*for (выраж1; выраж2; выраж3) {
        оператор;
    }*/

    /* "Зануление" массива */
    for (i = 0; i < 10; i++) {
        arr[i] = 0;
    }

    /* Оператор break
      while (выражение1) {
          ...
          if (выражение2)
              break;
          ...
      }
    */

    /* Оператор continue
      while (выражение1) {
          ...
          if (выражение2)
              continue;
          ...
      }
    */

    /* 12. Функции */
    a = -13;
    a = abs(a);

    c = arr_max(arr, 10);

    /* Бесконечный цикл. Необходим для микроконтроллера */
    //for(;;);
    //while(1);
}


/* Абсолютное значение числа */
int abs(int n)
{
    if (n < 0)
        return -n;
    else
        return n;
}

/* Поиск максимального элемента в массиве */
int arr_max(int a[], int n)
{
    int max = a[0];
    for (int i = 1; i < n; i++)
        if (a[i] > max)
            max = a[i];
    return max;
}
