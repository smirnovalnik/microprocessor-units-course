/**
  ******************************************************************************
  * \file    main.c
  * \author  Александр Смирнов
  * \version 1.0.0
  * \date    1.02.2022
  * \brief   Программа на языке C для учебного стенда на базе
  *          STM32F072RBT6 в среде разработки Keil uVision 5.
  *          Подключение библиотек поддержки МК STM32F072RBT6 осуществляется
  *          средствами IDE Keil через Run-Time Enviroment (RTE).
  *          При нажатии на кнопку SB1 включается светодиод LED1.
  *          Определения события нажатия по прерыванию.
  *          Программа работает в режиме 0 учебного стенда (S1 = 0, S2 = 0).
  ******************************************************************************
  */

/* Подключение заголовочного файла с макроопределениями всех регистром специальных
   функций МК STM32F072RBT6. */
#include <stm32f0xx.h>

/* Функция инициализации светодиода LED1 */
void led1_init(void)
{
    /* Включение тактирования порта C */
    RCC->AHBENR |= RCC_AHBENR_GPIOCEN;

    /* Настройка на вывод линии PC0 (LED1) */
    GPIOC->MODER |= GPIO_MODER_MODER0_0;
}

/* Функция включения светодиода LED1 */
void led1_on(void)
{
    /* Включаем LED1 сбросом в 0 бита 0 */
    GPIOC->ODR &= ~1;
}

/* Функция отключения светодиода LED1 */
void led1_off(void)
{
    /* Выключаем LED установкой в 1 бита 0 */
    GPIOC->ODR |= 1;
}

/* Функция инициализации кнопки SB1 */
void sb1_init(void)
{
    /* Включение подтягивающих резисторов PB4 (SB1) */
    GPIOB->PUPDR = GPIOB->PUPDR | GPIO_PUPDR_PUPDR4_0;

    /*  */
    EXTI->IMR |= EXTI_IMR_MR4;

    /*  */
    EXTI->FTSR |= EXTI_FTSR_FT4;

    /*  */
    NVIC_SetPriority(EXTI4_15_IRQn, 0);

    /*  */
    NVIC_EnableIRQ(EXTI4_15_IRQn);
}

/* Перечисление с состояниями кнопки */
typedef enum {
    SB_PRESSED,     /* Кнопка нажата */
    SB_UNPRESSED    /* Кнопка отжата */
} sb_state_t;

/* Функция получения состояния кнопки SB1 с антидребезгом */
sb_state_t sb1_get_state(void)
{
    /* Чтение состояния кнопки SB1 */
    uint16_t pin = (GPIOB->IDR >> 4) & 1;

    /* Если состояние SB1 было 0, то кнопка нажата */
    if (pin == 0)
        return SB_PRESSED;
    else
        return SB_UNPRESSED;
}

/* Подпрограмма обработчик прерываний от запросов на внешние прерывания
   портов ввода/вывода по линиям 4-15 */
void EXTI4_15_IRQHandler(void)
{
    EXTI->PR |= EXTI_PR_PIF4;

    if (sb1_get_state() == SB_PRESSED)
        led1_on();
    else
        led1_off();
}

/* Функция main - точка входа в программу */
int main(void)
{
    /* Инициализации светодиода LED1 */
    led1_init();
    /* Инициализация кнопки SB1 */
    sb1_init();

    /* Глобальное разрешение прерываний */
    __enable_irq();

    /* Бесконечный цикл */
    while (1)
    {
        /* Основные действия происходят в подпрограмме обработчике
           прерываний - EXTI4_15_IRQHandler. Здесь можно поместить
           другие задачи или например перевести МК в энергосберегающий режим
           с помощью функции __wfi();
        */
    }
}
