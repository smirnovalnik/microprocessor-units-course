; \file    main.c
; \author  Александр Смирнов
; \version 1.0.0
; \date    19.08.2022
; \brief   Пример программа для лабораторной работы №4 на языке Ассемблер
;          для учебного стенда на базе STM32F072RBT6
;          в среде разработки Keil uVision 5.
;          Условие:
;          Разработать программу, которая с небольшим интервалом времени
;          включает и выключает светодиод LED1.
;          Программа работает в режиме 0 учебного стенда (S1 = 0, S2 = 0).

; Макроопределения
; Начальный адрес регистров модуля RCC
RCC_BASE    EQU     0x40021000
; Адрес регистра AHBENR
RCC_AHBENR  EQU     RCC_BASE + 0x14

; Начальный адрес регистров модуля GPIOC
GPIOC_BASE  EQU     0x48000800
; Адрес регистра MODER
GPIOC_MODER EQU     0x48000800 + 0x00
; Адрес регистра ODR
GPIOC_ODR   EQU     0x48000800 + 0x14

; Макроопределение с длительностью задержки
DELAY       EQU     1000000

; Секция с программой
; Обязательная секция
            AREA    PROGRAM, CODE, READONLY     ; Указание на расположение программы в памяти
            ENTRY
            ALIGN

Reset_Handler
            ; Включить тактирование порта C
            LDR   r0, =RCC_AHBENR     ; Загрузить адрес регистра RCC_AHBENR в r0
            LDR   r1, =(1 << 19)      ; Загрузить маску порта C в r1
            STR   r1, [r0]            ; Сохранить r1 по адресу r0

            ; Настроить линию PC0(LED1) на вывод
            LDR   r0, =GPIOC_MODER    ; Загрузить адрес регистра GPIOC_MODER в r0
            LDR   r1, =0x01           ; Загрузить код 0x01 в r1
            STR   r1, [r0]            ; Сохранить r1 по адресу r0

            ; Основной цикл программы
Main_Loop
            ; Записать 1 в порт данных - включить светодиод PC0(LED1)
            LDR   r0, =GPIOC_ODR
            LDR   r1, =0x01
            STR   r1, [r0]

            ; Вызвать подпрограмму временной задержки
            BL    Delay

            ; Записать 0 в порт данных - выключить светодиод PC0(LED1)
            LDR   r0, =GPIOC_ODR
            LDR   r1, =0x00
            STR   r1, [r0]

            ; Вызвать подпрограмму временной задержки
            BL    Delay

            ; Безусловный переход на метку main_loop
            B     Main_Loop

            ; Подпрограмма программной временной задержки
Delay
            LDR   r0, =DELAY
Delay_Loop
            SUBS  r0, r0, #1
            BNE   Delay_Loop
            BX    lr


; Секция с таблицей векторов прерываний
            AREA    RESET, DATA, READONLY ; Указание на расположение векторов прерываний
            EXPORT  __Vectors   ; Метка __Vectors экспортируется из файла компоновщика
__Vectors
            DCD     0x20004000     ; Начало стека
            DCD     Reset_Handler  ; Вектор сброса

            END                    ; Команда транслятору об окончании текста программы