; \file    main.s
; \author  Александр Смирнов
; \version 1.0.0
; \date    8.09.2022
; \brief   Программа на языке Ассемблер (ARM) для учебного стенда на базе
;          STM32F072RBT6 в среде разработки Keil uVision 5.
;          Дан массив двухбайтовых чисел в дополнительном коде со знаком.
;          Начальный адрес массива – 0х20000000. Количество элементов – 10.
;          Отсортировать массив по возрастанию.

            ; Тестовый массив
            AREA    DATA, DATA, READONLY
ARR_ROM     DCW     42, 5, -4, 23, 84, -20, 19, 37, -15, 20

            ; Макроопределения
ARR_RAM     EQU     0x20000000                  ; Начальный адрес массива
ARR_LEN     EQU     10                          ; Длина массива

; Секция с программой
            AREA    PROGRAM, CODE, READONLY
            ALIGN
            ENTRY

Reset_Handler
            ; Копирование тестового массива из постоянной памяти в оперативную
            LDR     R0, =ARR_ROM
            LDR     R1, =ARR_RAM
            MOVS    R2, #0
Copy_Loop   LDRH    R3, [R0, R2]
            STRH    R3, [R1, R2]
            ADDS    R2, R2, #2
            CMP     R2, #(2 * ARR_LEN)
            BNE     Copy_Loop

            ; Сортировка массива
            LDR     R0, =ARR_RAM; Передача аргументов через регистры
            LDR     R1, =ARR_LEN
            BL      Bubble_Sort ; Вызов подпрограммы

Stop        B  Stop             ; Бесконечный цикл

            ; Подпрограмма сортировки пузырьком 2-х байтовых чисел
            ; в дополнительном коде со знаком.
            ; Аргументы:
            ; R0 - Адрес начала массива
            ; R1 - Длина массива/счетчик внешнего цикла
            ; Локальные переменные:
            ; R2 - счетчик внутреннего цикла
            ; R3 - смещение элемента i
            ; R4 - смещение элемента i + 1
            ; R5 - элемент i
            ; R6 - элемент i + 1
Bubble_Sort
            ; Сохранение на стеке
            PUSH    {R2-R6, LR}
            ; Инициализация счетчика внешнего цикла
            SUBS    R1, R1, #1
Sort_Loop_Out
            ; Инициализация счетчика внутреннего цикла
            MOVS    R2, R1
            ; Инициализация смещения
            MOVS    R3, #0
            MOVS    R4, #2
Sort_Loop_In
            ; Загрузка элементов
            LDRH    R5, [R0, R3]
            LDRH    R6, [R0, R4]
            ; Расширение чисел до 32-х разрядных
            SXTH    R5, R5
            SXTH    R6, R6
            ; Сравнение чисел
            CMP     R5, R6
            BLT     No_Swap
            ; Обмен элементов
            STRH    R5, [R0, R4]
            STRH    R6, [R0, R3]
No_Swap
            ; Инкремент смещения
            ADDS    R3, R3, #2
            ADDS    R4, R4, #2
            ; Декремент счетчика и проверка условия внутреннего цикла
            SUBS    R2, R2, #1
            BNE     Sort_Loop_In
            ; Декремент счетчика и проверка условия внешнего цикла
            SUBS    R1, R1, #1
            BNE     Sort_Loop_Out
            ; Восстановление из стека
            POP     {R2-R6, PC}

            ALIGN

            ; Секция с таблицей векторов прерываний
            AREA    RESET, DATA, READONLY ; Указание на расположение векторов прерываний
            EXPORT  Vectors         ; Экспорт метки Vectors для компоновщика
Vectors
            DCD     0x20004000      ; Начало стека (последний адрес ОЗУ)
            DCD     Reset_Handler   ; Вектор сброса (начало программы)

            END                     ; Команда транслятору об окончании текста программы
