; \file    main.s
; \author  Александр Смирнов
; \version 1.0.1
; \date    30.08.2022
; \brief   Пример программа для лабораторной работы №4 на языке Ассемблер
;          для учебного стенда на базе STM32F072RBT6
;          в среде разработки Keil uVision 5.
;          Условие:
;          Разработать программу, которая с небольшим интервалом времени
;          включает и выключает светодиод LED1.
;          Программа работает в режиме 0 учебного стенда (S1 = 0, S2 = 0).

            ; Макроопределения
RCC_BASE    EQU   0x40021000          ; Начальный адрес регистров модуля RCC
RCC_AHBENR  EQU   RCC_BASE + 0x14     ; Адрес регистра AHBENR

GPIOC_BASE  EQU   0x48000800          ; Начальный адрес регистров модуля GPIOC
GPIOC_MODER EQU   GPIOC_BASE + 0x00   ; Адрес регистра MODER
GPIOC_ODR   EQU   GPIOC_BASE + 0x14   ; Адрес регистра ODR

DELAY       EQU   1000000             ; Макроопределение с длительностью задержки

            ; Секция с программой
            AREA    PROGRAM, CODE, READONLY
            ENTRY
            ALIGN

Reset_Handler
            ; Включить тактирование порта C
            LDR   R0, =RCC_AHBENR     ; Загрузить адрес регистра RCC_AHBENR в r0
            LDR   R1, =(1 << 19)      ; Загрузить маску порта C в r1
            STR   R1, [R0]            ; Сохранить r1 по адресу r0

            ; Настроить линию PC0(LED1) на вывод
            LDR   R0, =GPIOC_MODER    ; Загрузить адрес регистра GPIOC_MODER в r0
            LDR   R1, =0x01           ; Загрузить код 0x01 в r1
            STR   R1, [R0]            ; Сохранить r1 по адресу r0

            ; Основной цикл программы
Main_Loop
            ; Записать 1 в порт данных - включить светодиод PC0(LED1)
            LDR   R0, =GPIOC_ODR
            LDR   R1, =0x01
            STR   R1, [R0]

            ; Вызвать подпрограмму временной задержки
            BL    Delay

            ; Записать 0 в порт данных - выключить светодиод PC0(LED1)
            LDR   R0, =GPIOC_ODR
            LDR   R1, =0x00
            STR   R1, [R0]

            ; Вызвать подпрограмму временной задержки
            BL    Delay

            ; Безусловный переход на метку Main_Loop
            B     Main_Loop

            ; Подпрограмма программной временной задержки (листовая)
Delay
            LDR   R0, =DELAY
Delay_Loop
            SUBS  R0, R0, #1
            BNE   Delay_Loop
            BX    LR

            ALIGN

            ; Секция с таблицей векторов прерываний
            AREA    RESET, DATA, READONLY ; Указание на расположение векторов прерываний
            EXPORT  Vectors         ; Экспорт метки Vectors для компоновщика
Vectors
            DCD     0x20004000      ; Начало стека (последний адрес ОЗУ)
            DCD     Reset_Handler   ; Вектор сброса (начало программы)

            END                     ; Команда транслятору об окончании текста программы
